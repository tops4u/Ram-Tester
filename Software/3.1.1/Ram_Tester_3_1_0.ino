/*
=====================================
RAM Tester Program for RAM Tester PCB
=====================================

Author:   Andreas Hoffmann
Project:  github.com/tops4u/ram-tester
Version:  3.1.0
Date:     04.12.2025

This software is published under GPL 3.0. Respect the license terms.
Project hosted at: https://github.com/tops4u/Ram-Tester/

Note: The code contains duplication and is not designed for elegance or efficiency.
The goal was to make it work lightning fast!

=======================================================================================
 LED BLINK CODE REFERENCE
=======================================================================================
 The bi-color LED is used to indicate test results, detected RAM type, 
 and error conditions.
 
 Blink sequences are grouped into two parts:
   1. GREEN blinks  -> Success indicator (all tests passed)
   2. ORANGE blinks -> RAM type identification

 Sequence format: [GREEN blinks] pause [ORANGE blinks] pause → repeats

---------------------------------------------------------------------------------------
 SUCCESS CODES (RAM detected and tested OK)
---------------------------------------------------------------------------------------
   1 GREEN, 1 ORANGE : 4164   (64Kx1, 16-pin)
   1 GREEN, 2 ORANGE : 41256  (256Kx1, 16-pin)
   1 GREEN, 3 ORANGE : 41257  (256Kx1 Nibble Mode, 16-pin)
   2 GREEN, 1 ORANGE : 4416   (16Kx4, 18-pin)
   2 GREEN, 2 ORANGE : 4464   (64Kx4, 18-pin)
   3 GREEN, 1 ORANGE : 514256 (256Kx4, 20-pin)
   3 GREEN, 3 ORANGE : 514258 (256Kx4 Static Column, 20-pin)
   3 GREEN, 2 ORANGE : 514400 (1Mx4, 20-pin)
   3 GREEN, 4 ORANGE : 514402 (1Mx4 Static Column, 20-pin)
   2 GREEN, 3 ORANGE : 411000 (1Mx1, 18-pin)
   4 GREEN, 1 ORANGE : 4116   (16Kx1, tested via 20-pin adapter)
   1 GREEN, 4 ORANGE : 4816   (16Kx1, 16-pin)

---------------------------------------------------------------------------------------
 ERROR CODES (RAM missing, wiring issue, or failure during testing)
---------------------------------------------------------------------------------------
   Continuous fast RED blinks    : Configuration error (tester setup failure)
   Continuous slow RED blinks    : No RAM detected in socket
   RED/ORANGE alternating blinks : Address line error (row/column mismatch)
   RED blinks, pause, repeat     : Data error (pattern mismatch at given row/col)
   Steady RED (no blinking)      : Critical hardware fault

---------------------------------------------------------------------------------------
 NOTE: 
 - Error codes are generated by error() and ConfigFail() functions.
 - When an error is found, the test stops and the corresponding blink code repeats.
 - Success codes repeat continuously until power is removed or reset.
=======================================================================================

Assumptions:
- The DRAM supports Page Mode for reading and writing.
- DRAMs with a 4-bit data bus are tested column by column using these patterns: `0b0000`, `0b1111`, `0b1010`, and `0b0101`.
- The program does not test RAM speed (access times) but Data retention Times
- This Software does not test voltage levels of the output signals
- This Software checks address decoding and crosstalk by using on run with pseudo randomized data.

Version History:
- 1.0         Initial implementation for 20-pin DIP/ZIP, supporting 256x4 DRAM (e.g., MSM514256C).
- 1.1         Added auto-detection for 1M or 256k x4 DRAM.
- 1.2         Support for 256kx1 DRAM (e.g., 41256).
- 1.21        Added column address line checks for 41256/4164, ensuring all address lines, buffers, and column decoders work.
- 1.22        Added checks for 4164/41256 DRAMs.
- 1.23        Added row address checking for 4164/41256, complementing column checks from version 1.21.
- 1.3         Full row and column tests for pins, buffers, and decoders on 514256 and 441000 DRAMs.
- 1.4         Support for 4416/4464 added. Only 4416 tested as 4464 test chips were unavailable.
- 2.0pre1     Introduced row crosstalk and refresh time checks (2ms for 4164, 4ms for 41256, 8ms for 20-pin DRAM types).
- 2.0pre      Refresh tests for 4416/4464 not yet included. Enabled ground short tests and cleaned 20-pin code section.
- 2.0         Fixed bugs for 4464 and adjusted refresh timing. To-do:
              Handle corner cases during crosstalk tests.
              Consider reverse-order testing (start with the last row).
- 2.1         Added a test mode for installation checks after soldering. Test mode instructions available on GitHub.
              To exit test mode: set all DIP switches to ON, reset, set DIP switches to OFF, and reset again.
- 2.1.1       Fixed minor bugs in test patterns and I/O configuration for 18-pin RAM.
- 2.1.2       Bug fix for 18Pin Versions (error in address line to physical port decoding)
- 2.2.0a      Adding Static Column Tests for 514258
- 2.2.0b      Added Random Bit Test for 20pin Types - this slightly prolonges Testing / Timing adjustment for FP-RAM pending
- 2.3.0a      Major rework on Retention Testing. Introduced RAM Types for timing. Added OLED support.
              Speed optimization in the Code to keep longer test times of pseudo random data at bay.
              Minor Bugfix 16Bit had one col/row overrun - buggy but no negativ side effects
              OLED Tests and final implementation missing
- 2.3.0.pre   All functional targets for 2.3.0 are met. OLED Tested and working
- 2.3.0.pre2  Checked and updated all Retention Timings. Fixed some minor Typos. Added 514402 Static Column 1Mx4 RAM
- 2.3.0       Option to deactivate OLED in Code (remove the line: #define OLED)
              Code Version output in DIP Switch Error Screen.
- 2.3.1       Improved Address & Decoder Checks
              RAM Inserted? Display
- 2.3.1.fix   Timing issue with 20Pin address tests
- 2.4.0       Implemented Tests for 41C1000 DIP 1Mx1 Chip
              Various speed improvements for all RAM, resulting in up to 40% shorter Tests
- 2.4.1       Added Randomdata inversion for every second run. This ensures all Cells are 
              Retention Tested if the user wants this. This is using the EEPROM but with wear leveling
- 2.4.2       Bugfix for EEPROIM wear leveling algorithm. It stopped working after the first EEPROM Cell was full. 
- 2.5.0       Implementation for Adapterboard for 4116 RAM
- 2.5.1       Fixing some Bugs from 2.5.0 and introducing better RAM Present checks
              Code restructured into modular architecture with separate files for each pin configuration
              Support for HM4816 added
- 3.0.0       New Major Version due to significant changed in code and behaviour. 
              Fixed a minor Bug in 20 Pin Testing. For Patterns 0 & 1 only the first 256 Col have been tested still broken cells are detected in later tests.
              Fixed a bug that might cause False Positives in Retention/Random Testing 
- 3.0.1       Bugfix: Missing IO Direction Switching for Patterns 0&1 leads to false positive for 20Pin
- 3.1.0       New RAMs supported: 4816 16kx1 like 4164 without -5V/12V and 4027 -> Requires 4116 Adapter: 4Kx1 requires -5V/12V

Disclaimer:
This project is for hobbyist use. There are no guarantees regarding its fitness for a specific purpose
or its error-free operation. Use it at your own risk.

----------------------------- COPYRIGHT INFORMATION -----------------------------

 * This project uses components of the Arduino platform, licensed under the LGPL 2.1:
 * - Arduino Core (Arduino.h, EEPROM.h)
 * -----------------------------
 * It also uses avr-libc (avr/pgmspace.h, avr/io.h), licensed under a BSD-style license.
 * -----------------------------
 * This product uses the U8g2 graphics library.
 * 
 * Copyright (c) 2016, olikraus
 * All rights reserved.
 *
 * Redistribution and use in source and binary forms, with or without
 * modification, are perwithted provided that the following conditions are met:
 *
 * 1. Redistributions of source code must retain the above copyright notice,
 *    this list of conditions and the following disclaimer.
 * 
 * 2. Redistributions in binary form must reproduce the above copyright notice,
 *    this list of conditions and the following disclaimer in the documentation
 *    and/or other materials provided with the distribution.
 * 
 * THIS SOFTWARE IS PROVIDED BY THE COPYRIGHT HOLDERS AND CONTRIBUTORS "AS IS"
 * AND ANY EXPRESS OR IMPLIED WARRANTIES, INCLUDING, BUT NOT LIMITED TO,
 * THE IMPLIED WARRANTIES OF MERCHANTABILITY AND FITNESS FOR A PARTICULAR PURPOSE
 * ARE DISCLAIMED. IN NO EVENT SHALL THE COPYRIGHT HOLDER OR CONTRIBUTORS BE
 * LIABLE FOR ANY DIRECT, INDIRECT, INCIDENTAL, SPECIAL, EXEMPLARY, OR
 * CONSEQUENTIAL DAMAGES (INCLUDING, BUT NOT LIMITED TO, PROCUREMENT OF
 * SUBSTITUTE GOODS OR SERVICES; LOSS OF USE, DATA, OR PROFITS; OR BUSINESS
 * INTERRUPTION) HOWEVER CAUSED AND ON ANY THEORY OF LIABILITY, WHETHER IN
 * CONTRACT, STRICT LIABILITY, OR TORT (INCLUDING NEGLIGENCE OR OTHERWISE)
 * ARISING IN ANY WAY OUT OF THE USE OF THIS SOFTWARE, EVEN IF ADVISED OF THE
 * POSSIBILITY OF SUCH DAMAGE.
 */


//=======================================================================================
// INCLUDES
//=======================================================================================

// Version String
#define version "3.1.0"

#include "common.h"
#include "16Pin.h"
#include "18Pin.h"
#include "20Pin.h"

/**
 * Arduino setup function - initializes hardware and starts appropriate RAM test
 * Configures I/O ports, reads DIP switches to determine RAM type, and routes to test functions
 */
void setup() {
#ifdef OLED
  display.begin();
  display.setBusClock(10000000);
  display.setPowerSave(0);
  display.setFont(u8x8_font_7x14B_1x2_r);
  oledDrawCentered(0, "RAM-TESTER");
#endif
  // Data Direction Register Port B, C & D - Preconfig as Input (Bit=0)
  DDRB &= 0b11100000;
  DDRC &= 0b11000000;
  DDRD = 0x00;
  
  // If TESTING is set enter "Factory Test" Mode
  if (EEPROM.read(TESTING) != 0) {
#ifdef DIAG
    buildTest();
#endif
  }
  
  // Wait for the Candidate to properly Startup
  if (digitalRead(19) == 1) {
    Mode += Mode_20Pin;
  }
  if (digitalRead(3) == 1) {
    Mode += Mode_18Pin;
  }
  if (digitalRead(2) == 1) {
    Mode += Mode_16Pin;
  }
  
  // Check if the DIP Switch is set for a valid Configuration.
  if (Mode < 2 || Mode > 5) {
#ifdef OLED
    display.clearDisplay();
    display.setFont(u8x8_font_open_iconic_embedded_4x4);
    display.drawString(6, 0, "H");
    display.setFont(u8x8_font_7x14B_1x2_r);
    oledDrawCentered(5, "DIP Settings!");
    display.setFont(u8x8_font_5x7_r);
    display.drawString(4, 7, "Ver:");
    display.drawString(8, 7, version);
#endif
    ConfigFail();
  }
  
  // With a valid Config, activate the PullUps
  PORTB |= 0b00011111;
  PORTC |= 0b00111111;
  PORTD = 0xff;
  digitalWrite(13, ON);  // Switch the LED on PB5 on for the rest of the test as it will show as yellow not to confuse Users as steady green.
  
  // Settle State - PullUps may require some time.
  checkGNDShort();  // Check for Shorts towards GND. Shorts on Vcc can't be tested as it would need Pull-Downs.
  
  // Startup Delay as per Datasheets
  delayMicroseconds(200);
  
  if (Mode == Mode_20Pin) {
    initRAM(RAS_20PIN, CAS_20PIN);
    test_20Pin();
  }
  if (Mode == Mode_18Pin) {
    initRAM(RAS_18PIN, CAS_18PIN);
    test_18Pin();
  }
  if (Mode == Mode_16Pin) {
    initRAM(RAS_16PIN, CAS_16PIN);
    test_16Pin();
  }
}

//=======================================================================================
// ARDUINO MAIN LOOP
//=======================================================================================

/**
 * Arduino main loop - should never be reached during normal operation
 * If reached, indicates a configuration failure and triggers error indication
 */
void loop() {
  ConfigFail();
}