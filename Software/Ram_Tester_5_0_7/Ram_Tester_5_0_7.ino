/*
=====================================
RAM Tester Program for RAM Tester PCB
=====================================

Author:   Andreas Hoffmann
Project:  github.com/tops4u/ram-tester
Version:  5.0.6
Date:     13.06.2026

This software is published under GPL 3.0. Respect the license terms.
Project hosted at: https://github.com/tops4u/Ram-Tester/

Note: The code contains duplication and is not designed for elegance or efficiency.
The goal was to make it work lightning fast!

=======================================================================================
 LED BLINK CODE REFERENCE
=======================================================================================
 The bi-color LED is used to indicate test results, detected RAM type,
 and error conditions.

 Blink sequences are grouped into two parts:
   1. GREEN blinks  -> Success indicator (all tests passed)
   2. ORANGE blinks -> RAM type identification

 Sequence format: [GREEN blinks] pause [ORANGE blinks] pause → repeats

---------------------------------------------------------------------------------------
 SUCCESS CODES (RAM detected and tested OK)
---------------------------------------------------------------------------------------
   1 GREEN, 1 ORANGE : 4164   (64Kx1, 16-pin)
   1 GREEN, 2 ORANGE : 41256  (256Kx1, 16-pin)
   1 GREEN, 3 ORANGE : 41257  (256Kx1 Nibble Mode, 16-pin)
   1 GREEN, 4 ORANGE : 4816   (16Kx1, 16-pin)
   1 GREEN, 5 ORANGE : TMS4532  (32Kx1, 16-pin, half-good 4164, -3/-4 on OLED)
   1 GREEN, 6 ORANGE : MSM3732  (32Kx1, 16-pin, half-good 4164, -L/-H on OLED)
   1G-5O then 1G-6O  : Ambiguous (single quadrant, could be TMS4532 or MSM3732)

   2 GREEN, 1 ORANGE : 4416   (16Kx4, 18-pin)
   2 GREEN, 2 ORANGE : 4464   (64Kx4, 18-pin)
   2 GREEN, 3 ORANGE : 411000 (1Mx1, 18-pin)
   2 GREEN, 4 ORANGE : 2114   (1Kx4, 18-pin)

   3 GREEN, 1 ORANGE : 514256 (256Kx4, 20-pin)
   3 GREEN, 2 ORANGE : 514400 (1Mx4, 20-pin)
   3 GREEN, 3 ORANGE : 514258 (256Kx4 Static Column, 20-pin)
   3 GREEN, 4 ORANGE : 514402 (1Mx4 Static Column, 20-pin)

   4 GREEN, 1 ORANGE : 4116   (16Kx1, tested via 20-pin adapter)
   4 GREEN, 2 ORANGE : 4027   (4Kx1, tested via 20-pin adapter)

---------------------------------------------------------------------------------------
 ERROR CODES (RAM missing, wiring issue, or failure during testing)
---------------------------------------------------------------------------------------
   Continuous fast RED blinks    : Configuration error (DIP switch invalid)
   Continuous slow RED blinks    : No RAM detected in socket
   1 RED, n ORANGE blinks        : Address line error (n = address line number 0-15)
   2 RED, 1/2 ORANGE blinks      : Checkerboard error (1 = pass 0 up, 2 = pass 1 down; OLED: "Error Checkerboard")
   2 RED, 7 ORANGE blinks        : Random pattern / retention error (patterns 4-5; OLED: "Error RandomData")
   2 RED, 8 ORANGE blinks        : CBR refresh-counter fault (OLED: "CBR Timer fault"; loop-mode CBR test)
   3 RED, 0 ORANGE blinks        : Address line short (two address lines shorted)
   3 RED, n ORANGE blinks        : Ground short (n = pin number)
   4 RED, n ORANGE blinks        : 2114 SRAM error - chip present but failed test
                                   (OLED: "SRAM Error n"; n = 1/2 _CS/_WE control, 3-7 March C- M1-M5)

---------------------------------------------------------------------------------------
 NOTE:
 - Error codes are generated by error() and ConfigFail() functions in common.cpp
 - When an error is found, the test stops and the corresponding blink code repeats
 - Success codes repeat continuously until power is removed or reset button pressed
=======================================================================================

Test Methodology:
- All DRAMs are tested using Page Mode for reading and writing
- Coupling faults verified with a checkerboard ((row ^ col) & 1), run up and down
- Program tests data retention times (not access times or voltage levels)
- Address decoding and crosstalk verified using pseudo-randomized data patterns
- Special handling for 3732 & 4532 chips (half-functional 4164 variants)

Test Patterns (in order):
  0. Checkerboard, ascending rows  (coupling / stuck-at, each cell 0 and 1)
  1. Checkerboard, descending rows (inverted, opposite aggressor ordering)
  4. Random pattern (address decoder and crosstalk test)
  5. Random pattern inverted (full coverage retention test)

Version History:
- 1.0         Initial implementation for 20-pin DIP/ZIP, supporting 256x4 DRAM (e.g., MSM514256C).
- 1.1         Added auto-detection for 1M or 256k x4 DRAM.
- 1.2         Support for 256kx1 DRAM (e.g., 41256).
- 1.21        Added column address line checks for 41256/4164, ensuring all address lines, buffers, and column decoders work.
- 1.22        Added checks for 4164/41256 DRAMs.
- 1.23        Added row address checking for 4164/41256, complementing column checks from version 1.21.
- 1.3         Full row and column tests for pins, buffers, and decoders on 514256 and 441000 DRAMs.
- 1.4         Support for 4416/4464 added. Only 4416 tested as 4464 test chips were unavailable.
- 2.0pre1     Introduced row crosstalk and refresh time checks (2ms for 4164, 4ms for 41256, 8ms for 20-pin DRAM types).
- 2.0pre      Refresh tests for 4416/4464 not yet included. Enabled ground short tests and cleaned 20-pin code section.
- 2.0         Fixed bugs for 4464 and adjusted refresh timing.
- 2.1         Added a test mode for installation checks after soldering. Test mode instructions available on GitHub.
              To exit test mode: set all DIP switches to ON, reset, set DIP switches to OFF, and reset again.
- 2.1.1       Fixed minor bugs in test patterns and I/O configuration for 18-pin RAM.
- 2.1.2       Bug fix for 18Pin Versions (error in address line to physical port decoding)
- 2.2.0a      Adding Static Column Tests for 514258
- 2.2.0b      Added Random Bit Test for 20pin Types - this slightly prolongs Testing
- 2.3.0a      Major rework on Retention Testing. Introduced RAM Types for timing. Added OLED support.
              Speed optimization in the Code to keep longer test times of pseudo random data at bay.
              Minor Bugfix 16Bit had one col/row overrun - buggy but no negative side effects
- 2.3.0.pre   All functional targets for 2.3.0 are met. OLED Tested and working
- 2.3.0.pre2  Checked and updated all Retention Timings. Fixed some minor Typos. Added 514402 Static Column 1Mx4 RAM
- 2.3.0       Option to deactivate OLED in Code (remove the line: #define OLED)
              Code Version output in DIP Switch Error Screen.
- 2.3.1       Improved Address & Decoder Checks. RAM Inserted? Display
- 2.3.1.fix   Timing issue with 20Pin address tests
- 2.4.0       Implemented Tests for 41C1000 DIP 1Mx1 Chip
              Various speed improvements for all RAM, resulting in up to 40% shorter Tests
- 2.4.1       Added Random data inversion for every second run. This ensures all Cells are
              Retention Tested if the user wants this. This is using the EEPROM but with wear leveling
- 2.4.2       Bugfix for EEPROM wear leveling algorithm. It stopped working after the first EEPROM Cell was full.
- 2.5.0       Implementation for Adapter board for 4116 RAM
- 2.5.1       Fixing some Bugs from 2.5.0 and introducing better RAM Present checks
              Code restructured into modular architecture with separate files for each pin configuration
              Support for HM4816 added
- 3.0.0       New Major Version due to significant changes in code and behaviour.
              Fixed a minor Bug in 20 Pin Testing. For Patterns 0 & 1 only the first 256 Col have been tested still broken cells are detected in later tests.
              Fixed a bug that might cause False Positives in Retention/Random Testing
- 3.0.1       Bugfix: Missing IO Direction Switching for Patterns 0&1 leads to false positive for 20Pin
- 3.1.0       New RAMs supported: 4816 16kx1 like 4164 without -5V/12V and 4027 -> Requires 4116 Adapter: 4Kx1 requires -5V/12V
- 3.1.1       Fixed 4027 Detection Routine
- 4.0.0.alpha Code Streamlining. 
              Added Help and Selfcheck Functions.
              Preliminary Support for 4532 (half-functional 4164 variants: 4532-L and 4532-H)
              Hidden CAS before RAS Refresh checks for all Rams that support this. 
              Open Points: Verify 4532 RAMS / Verify Refresh Check Delays. 
- 4.0.1       Adapted for 1Bit RAM witch has connected Din to Dout for in Circuit tests, like CBM A501
- 4.0.5       Fix 41257 Problems with Write - Read for early Patterns and shorten RAS_HOLD_TIME for subsequent tests 
              Add 41257 RAM Detection
              Speedup RAM and Display Operations, added Support for 41257 nibble Mode testing - No retention Test yet!
              OKI 3732 Detection fix, but Test Sequence needs to be fixed
- 4.0.6       OKI MSM3732-H Type implemented. Todo: Retention Tuning, 3732-L verification, 4532 verification, 41257 retention Tuning
- 4.1.0       Retention Tests tuned for TMS4532 and MSM3732. 
              TMS4532 simulated by 4164 RAM - but real HW test is still open
              Minor Bugfix for 16Pin Logic, delay fault when testing last Row in Retention Tests 
- 4.1.1       Minor Fix in 18Pin Retention Timing Logic
              Added explicit Addressline - Short detection. This detects if address lines have shorts with another adresseline.
              Added 4164 4ms vs 2ms Tests. If a 4164 fails the 4ms Test, it is retested with 2ms. This is clearly indicated in the Display.
              Fixed wrong retention times for MSM3732! Was 4ms instead of 2ms.
- 4.2.1       Fixed 4532 behaviour and in consequencec the 3732 to match. Now errors are assigned to quadrants. Depending on how many
              faults are detected an which quadrants are affected the RAM will be classified into one of 10 categories. 4x one of the 4 Subtypes
              4x combinations of subtypes, a plain 4164 or simply a defect chip. 
- 4.2.2       Minor Text changes
              Minor Edge Case fix for TMS4532
              Adapted Blink Codes for MSM3732/TMS4532
- 4.2.3       Modifiy Version String depending on ENABLE_32K
- 4.3.0       Include 2114 SRAM
              Bugfix for 41257 Nibble Mode Check during Pattern 4&5, which was introduced by Quadrant Logic in 4.2.3
- 5.0.0       Configuration Modes included (Enable 32K Checks, Loop Mode Checking, Display Dimming)
              Including heavily modified U8G2 Lib. The License for it and the used Fonts is in the SourceCode Dir
- 5.0.1       Bugfixing possible False Negatives due to excessive Row Retention in FastTestRoutines (Pattern 0-3)
              Instead of Patterns 0-3 we skip all 0 and all 1 for a Up/Downward mixed Checkerboard over 2 Rows which,
                 is way more efficient in finding fault, except for 4164 which will be fixed in 5.0.2 due to the complexity of quadrant logic.
              Increased CBR Test Time to 1 Sec. to have more reliable check of real retention faults if CBR fails.
              Further Bugfix for 41257 Fastcheck
- 5.0.2       Fixes timing issues for 18Pin RAM
              Fixes reverse Entry of 2114 as Vcc <-> GND that only popped up when test ram arrived.
- 5.0.3       Checkerboard restructured to write-all -> read-all with CBR ("hidden refresh")
              recycle, to add inter-row disturb/coupling coverage. For RAM with Row Counter only
              CBR Counter Tests active only during loop tests as this will take at least 1 Min
- 5.0.4       Minor Timing Fix for 4116 RAM and adjustments to behave like 4816
              Adjusted 2114 Timings to fit for very slow types (450ns)
              Coverage/QA review fixes:
              - Column-A7 address-check skip for CAS-split half-good chips (MSM3732) —
                symmetric to the existing row-A7 skip for TMS4532 (32K mode only)
              - 16Pin random path: RAS recycle now also fires at chunk boundaries
                (bursts no longer merge to 2x length across 32-col chunks)
              - 4416: RAS recycle every 2 columns instead of 8 (10us tRAS-max spec)
              - Bugfix: 4464 loop-mode CBR failure reported nonexistent error type 7
                (LED stayed dark) — now reports type 5 "CBR Timer fault"
              - OLED error texts: "Failed Pattern n" -> "Error Checkerboard" / "Error RandomData"
              - Retention-aging tail of patterns 4-5 factored into shared retentionTail()
                (flash savings; 20-pin tail order normalised to delay-before-check)
- 5.0.5       Timing fixes (t_RAS max). The NMOS generation (4164/41256/4116/4416/4464/4027…) specs
              t_RAS ≤ 10 µs with no page-mode allowance. Several write/verify loops exceeded this
              (measured 12–52 µs). All paths now recycle RAS via a fast row-snapshot restore —
              worst-case RAS-low window is ~7.5 µs on every type. Retention calibration retuned to
              match: all types now age 98–104% of their refresh spec at read-back (was 85–112%).
              Fixes
              - 18-pin address-short test: corrected pin masks — no more out-of-spec current into a
                supply-railed pin, and A5–A7 are now actually tested.
              - CBR counter test (41256/41257/4464/411000): display updates no longer starve refresh
                (screen renders before the write phase, steady ~15 µs CBR cadence, catch-up bursts) —
                fixes possible false "CBR Timer fault" on marginal chips.
              - 4416 checkerboard: rewritten as a 2-row write/read pipeline so rows stay inside the
                4 ms refresh spec during the test (previously up to ~190 ms unrefreshed).
              - 16-pin read sampling margin fix; deterministic CAS pulse widths; loop mode now works
               in non-OLED builds.
- 5.0.6       - Improvement in LED Handling during Self-Test if one is not using a Display. As long as
                the "20-Pin to all" has not completed, the LED will only flash briefly and then return to orange
                state. It is green when all tests were successful. 
              - Clear pin names für GND checks. Instead of Pin Numbers the Display now shows the signal names 
                except for 18 Pin RAM where it is ambiguous as long it is not known exactly what RAM it is, 
                as Pinouts differ between 4416/4464 - 441000 and 2114 SRAM.
              - 41257 Refresh Times adjusted to match Specs for Random Pattern / Retention Tests.
- 5.0.7       - Adjusted I2C Speed to 400kHz for weaker Displays in the TH-PCB Version.  
              
Disclaimer:
This project is for hobbyist use. There are no guarantees regarding its fitness for a specific purpose
or its error-free operation. Use it at your own risk.

----------------------------- COPYRIGHT INFORMATION -----------------------------

 * This project uses components of the Arduino platform, licensed under the LGPL 2.1:
 * - Arduino Core (Arduino.h)
 * -----------------------------
 * It also uses avr-libc (avr/pgmspace.h, avr/io.h), licensed under a BSD-style license.
 * -----------------------------
 * This product uses the U8g2 graphics library.
 *
 * Copyright (c) 2016, olikraus
 * All rights reserved.
 *
 * Redistribution and use in source and binary forms, with or without
 * modification, are permitted provided that the following conditions are met:
 *
 * 1. Redistributions of source code must retain the above copyright notice,
 *    this list of conditions and the following disclaimer.
 *
 * 2. Redistributions in binary form must reproduce the above copyright notice,
 *    this list of conditions and the following disclaimer in the documentation
 *    and/or other materials provided with the distribution.
 *
 * THIS SOFTWARE IS PROVIDED BY THE COPYRIGHT HOLDERS AND CONTRIBUTORS "AS IS"
 * AND ANY EXPRESS OR IMPLIED WARRANTIES, INCLUDING, BUT NOT LIMITED TO,
 * THE IMPLIED WARRANTIES OF MERCHANTABILITY AND FITNESS FOR A PARTICULAR PURPOSE
 * ARE DISCLAIMED. IN NO EVENT SHALL THE COPYRIGHT HOLDER OR CONTRIBUTORS BE
 * LIABLE FOR ANY DIRECT, INDIRECT, INCIDENTAL, SPECIAL, EXEMPLARY, OR
 * CONSEQUENTIAL DAMAGES (INCLUDING, BUT NOT LIMITED TO, PROCUREMENT OF
 * SUBSTITUTE GOODS OR SERVICES; LOSS OF USE, DATA, OR PROFITS; OR BUSINESS
 * INTERRUPTION) HOWEVER CAUSED AND ON ANY THEORY OF LIABILITY, WHETHER IN
 * CONTRACT, STRICT LIABILITY, OR TORT (INCLUDING NEGLIGENCE OR OTHERWISE)
 * ARISING IN ANY WAY OUT OF THE USE OF THIS SOFTWARE, EVEN IF ADVISED OF THE
 * POSSIBILITY OF SUCH DAMAGE.
 */


//=======================================================================================
// INCLUDES
//=======================================================================================

#include "common.h"
#include "16Pin.h"
#include "18Pin.h"
#include "20Pin.h"

//=======================================================================================
// ARDUINO SETUP FUNCTION
//=======================================================================================

/**
 * Initialize hardware and start appropriate RAM test based on DIP switch configuration
 *
 * This function is called once at startup and performs the following sequence:
 * 1. Initialize OLED display (if enabled)
 * 2. Configure all I/O ports as inputs with pullups disabled
 * 3. Read DIP switches to determine RAM pin configuration (16/18/20-pin)
 * 4. Validate DIP switch configuration
 * 5. Enable pullups on all I/O pins
 * 6. Check for ground shorts on all pins
 * 7. Initialize DRAM with RAS-only refresh cycles
 * 8. Route to appropriate test function based on pin configuration
 *
 * DIP Switch Configuration (read from pins 19, 3, 2):
 * - Pin 19 (A5): 20-pin mode if HIGH
 * - Pin 3 (D3): 18-pin mode if HIGH
 * - Pin 2 (D2): 16-pin mode if HIGH
 *
 * Valid configurations (only one pin should be HIGH):
 * - Mode_16Pin (2): Tests 4164, 41256, 41257, 4816, TMS4532, MSM3732
 * - Mode_18Pin (4): Tests 4416, 4464, 411000
 * - Mode_20Pin (5): Tests 514256, 514258, 514400, 514402, 4116, 4027
 *
 * Invalid configurations trigger ConfigFail() which shows error on OLED
 * and blinks LED in fast red pattern.
 *
 * Note: This function never returns during normal operation. Test functions
 * either call testOK() (infinite success blink) or error() (infinite error blink).
 */
void setup() {
  // Load EEPROM-backed runtime configuration (32K mode, Loop, Dim)
  loadConfig();

  // Configure all I/O ports as inputs (DDR=0 means input)
  // Preserve upper 3 bits of each port which may be used by Arduino core
  DDRB &= 0b11100000;  // PB0-PB4 as inputs (bits 5-7 preserved)
  DDRC &= 0b11000000;  // PC0-PC5 as inputs (bits 6-7 preserved for ADC)
  DDRD = 0x00;         // PD0-PD7 all as inputs

  // Read DIP switch configuration FIRST — direct port reads (pins 19=A5/PC5, 3=PD3, 2=PD2),
  // with every I/O pin still a high-Z input and BEFORE the OLED is initialised. The OLED
  // SW-I2C SDA line is PB4, which in the rotated 2114 socket mapping is the chip's A3
  // address pin; display.begin() drives PB4 HIGH and that 5V back-feeds (phantom-powers) a
  // chip in the socket through its input protection diode. Reading the mode while all pins
  // are quiet keeps the socket un-driven during detection.
  if (PINC & (1 << PC5)) Mode += Mode_20Pin;  // A5 -> 20-pin mode
  if (PIND & (1 << PD3)) Mode += Mode_18Pin;  // D3 -> 18-pin mode
  if (PIND & (1 << PD2)) Mode += Mode_16Pin;  // D2 -> 16-pin mode

  // Early-park the 4116/4027 strobes (PB0-3 = CAS/RAS/OE/WE) on internal pull-ups now that
  // the (quiet-pin) DIP read is done, but BEFORE display.begin()'s multi-ms init. Keeps the
  // NMOS clock inputs from floating after a reset (a 4027 latches/hangs otherwise). Pull-up
  // only (not driven -> Imax-safe); PB4 (SW-I2C SDA, phantom-power note above) left untouched.
  PORTB |= 0b00001111;

#ifdef OLED
  // Initialize OLED display with I2C bus at 400kHz for faster updates
  display.begin();
  display.setPowerSave(0);
  // Apply user-selected display brightness (dim = ~25% of normal contrast)
  display.setContrast(CFG_DIM_ACTIVE ? 64 : 255);
#endif

  // All three DIP switches ON -> enter EEPROM runtime configuration page.
  // Mode_16Pin(2) + Mode_18Pin(4) + Mode_20Pin(5) = 11. Never returns.
  if (Mode == (Mode_16Pin + Mode_18Pin + Mode_20Pin)) {
    enterConfigMode();
  }

  // Validate DIP switch configuration (a single switch sets Mode to its constant)
  // Valid: Mode_16Pin(2), Mode_18Pin(4), Mode_20Pin(5)
  // Invalid: 0/1 (no switch) or 6/7/9 (multiple switches); Mode 3 is unreachable
  if (Mode < 2 || Mode > 5) {
#ifdef OLED
    if (Mode < 2)
      selfCheck();
    // Display configuration error with QR code to documentation
    printQRandVersion(F("Check DIP"));
#endif
    ConfigFail();  // Never returns - infinite fast red blink
  }

  // Enable pullup resistors on all I/O pins for proper signal detection
  // Pullups allow detection of floating pins and ground shorts
  PORTB |= 0b00011111;  // Enable pullups on PB0-PB4
  PORTC |= 0b00111111;  // Enable pullups on PC0-PC5
  PORTD = 0xff;         // Enable pullups on all PORTD pins

  // Allow time for pullup resistors to charge pins to HIGH state
  // Check for any pins shorted to ground (would remain LOW with pullup enabled)
  checkGNDShort();  // Calls error() if short detected, never returns

  // DRAM startup delay as specified in datasheets
  // Most DRAMs require 200μs minimum after power-up before initialization
  // delayMicroseconds(200);
  // no longer needed all code before starting the INIT probably takes a lot more than 200us.

  // Generate pseudo-random test data table at startup
  // Saves 188 bytes flash compared to pre-populated table
  generateRandomTable();

  // Route to appropriate test function based on validated Mode
  // Each test function performs 8 RAS-only refresh cycles then runs full test suite
  if (Mode == Mode_20Pin) {
    initRAM(RAS_20PIN, CAS_20PIN);  // Initialize with 8 ROR cycles
    test_20Pin();                    // Never returns
  }
  if (Mode == Mode_18Pin) {
    initRAM(RAS_18PIN, CAS_18PIN);  // Initialize with 8 ROR cycles
    test_18Pin();                    // Never returns
  }
  if (Mode == Mode_16Pin) {
    initRAM(RAS_16PIN, CAS_16PIN);  // Initialize with 8 ROR cycles
    test_16Pin();                    // Never returns
  }
}

//=======================================================================================
// ARDUINO MAIN LOOP
//=======================================================================================

/**
 * Arduino main loop - should never be reached during normal operation
 *
 * This function is called repeatedly after setup() completes. However, in the
 * RAM Tester, setup() never returns because test functions end in infinite
 * loops (either testOK() for success or error() for failures).
 *
 * If this loop is somehow reached, it indicates a configuration failure or
 * unexpected code flow, so it triggers the configuration error state with
 * fast red LED blinking.
 *
 * Note: This is a safety fallback and should never execute in normal operation.
 */
void loop() {
  ConfigFail();  // Never returns - infinite fast red blink
}
